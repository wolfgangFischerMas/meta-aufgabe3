## conf/layer.conf
```bitbake
# We have a conf and classes directory, append to BBPATH
BBPATH .= ":${LAYERDIR}"

# We have a recipes directory containing .bb and .bbappend files, add to BBFILES
BBFILES += "${LAYERDIR}/recipes*/*/*.bb \
            ${LAYERDIR}/recipes*/*/*.bbappend"

BBFILE_COLLECTIONS += "aufgabe3"
BBFILE_PATTERN_aufgabe3 := "^${LAYERDIR}/"
BBFILE_PRIORITY_aufgabe3 = "10"

LAYERSERIES_COMPAT_aufgabe3 = "thud"
```
